## dreamcast_sh4_miner/linux-build/dreamcast_defconfig
```kconfig
# SPDX-License-Identifier: GPL-2.0
# Kernel config for Dreamcast + RustChain Miner

CONFIG_SH_DREAMCAST=y
CONFIG_SH7750=y
CONFIG_CPU_SUBTYPE_SH7750=y
CONFIG_SH_FPU=y
CONFIG_SH_DREAMCAST_TMU=y
CONFIG_MMU=y
CONFIG_MODULES=n
CONFIG_BLK_DEV_INITRD=y
CONFIG_NET=y
CONFIG_NET_ETHERNET=y
CONFIG_8139CP=y
CONFIG_INET=y
CONFIG_IP_PNP=y
CONFIG_IP_PNP_DHCP=y
CONFIG_TCP=y
CONFIG_TMPFS=y
CONFIG_DEVTMPFS=y
CONFIG_DEVTMPFS_MOUNT=y
CONFIG_SERIAL_SH_SCI=y
CONFIG_SERIAL_SH_SCI_CONSOLE=y
CONFIG_VT=y
CONFIG_VT_CONSOLE=y
CONFIG_TTY=y
CONFIG_PRINTK=y
CONFIG_FUTEX=n
CONFIG_MODULES=y
CONFIG_MODULE_UNLOAD=y
```
